#include "hal_data.h"
#include <stdio.h>
#include <string.h>
#include "UART_debug/uart_debug.h"
#include "Screen/screen_ui.h"

bool printf_screen = false;
uint8_t screen_ui_test_index = 0;

/* 本工程使用的是 ST7735 128*128 1.44寸 的屏幕，由于不带字库显示中文略显复杂 */
/* 里面驱动代码为原创 */
/* 屏幕相关资料在 https://pan.baidu.com/s/1PiJNGIKneVSB_7-v3qPSUQ?pwd=8888 */

/* 图片使用 image2lcd 取模 */
/* 字体使用 PCtoLCD2002 取模 */
/* 汉字取模完成之后，借助 python代码 convert_font.py 转化成适合本项目的代码 */

/* font_bitmap_gen.py : 可以实现字符取模 */
/* lcd_ui_designer.py : 可以实现简单的页面设计 */

#if (1 == BSP_MULTICORE_PROJECT) && BSP_TZ_SECURE_BUILD
bsp_ipc_semaphore_handle_t g_core_start_semaphore =
{
    .semaphore_num = 0
};
#endif

/*******************************************************************************************************************//**
 * main() is generated by the RA Configuration editor and is used to generate threads if an RTOS is used.  This function
 * is called by main() when no RTOS is used.
 **********************************************************************************************************************/
void hal_entry(void)
{
    /* TODO: add your own code here */
    UART_debug_ClearCmdBuffer();
    UART_debug_Init();

    SysTime_Init();

    ST7735_Hardware_Init();
    ST7735_Init();

    uint32_t time = 0;

    while(1){
        SCREEN_FillScreen(SCREEN_WHITE);
        SCREEN_DrawUITest(screen_ui_test_index);
        time = SCREEN_RefreshScreen();

        if(printf_screen == true){
            printf("time = %d ms\r\n",time);
        }

        if (UART_debug_HasCommand())
        {
            UART_CmdInfo_t cmd;
            UART_debug_ParseCommand(UART_debug_GetCmdBuffer(), &cmd);
            if (cmd.valid) {
                printf("CMD: %s, ARG: %s\r\n", cmd.cmd, cmd.arg);

                if (strcmp(cmd.cmd, "printf_screen") == 0) {
                    if(strcmp(cmd.arg, "0") == 0){
                        printf_screen = false;
                    } else if(strcmp(cmd.arg, "1") == 0){
                        printf_screen = true;
                    } else {
                        printf("Invalid argument for printf_screen. Use 0 or 1.\r\n");
                    }
                }
                else if (strcmp(cmd.cmd, "screen_test") == 0) {
                    if(strcmp(cmd.arg, "0") == 0){
                        screen_ui_test_index = 0;
                    } else if(strcmp(cmd.arg, "1") == 0){
                        screen_ui_test_index = 1;
                    } else if(strcmp(cmd.arg, "2") == 0){
                        screen_ui_test_index = 2;
                    } else if(strcmp(cmd.arg, "3") == 0){
                        screen_ui_test_index = 3;
                    } else if(strcmp(cmd.arg, "4") == 0){
                        screen_ui_test_index = 4;
                    } else if(strcmp(cmd.arg, "5") == 0){
                        screen_ui_test_index = 5;
                    } else {
                        printf("Invalid argument for printf_screen. \r\n");
                    }
                }
            }
            UART_debug_ClearCmdBuffer();
        }
    }

    /* Wake up 2nd core if this is first core and we are inside a multicore project. */
#if (0 == _RA_CORE) && (1 == BSP_MULTICORE_PROJECT) && !BSP_TZ_NONSECURE_BUILD

#if BSP_TZ_SECURE_BUILD
    /* Take semaphore so 2nd core can clear it */
    R_BSP_IpcSemaphoreTake(&g_core_start_semaphore);
#endif

    R_BSP_SecondaryCoreStart();

#if BSP_TZ_SECURE_BUILD
    /* Wait for 2nd core to start and clear semaphore */
    while(FSP_ERR_IN_USE == R_BSP_IpcSemaphoreTake(&g_core_start_semaphore))
    {
        ;
    }
#endif
#endif

#if (1 == _RA_CORE) && (1 == BSP_MULTICORE_PROJECT) && BSP_TZ_SECURE_BUILD
    /* Signal to 1st core that 2nd core has started */
    R_BSP_IpcSemaphoreGive(&g_core_start_semaphore);
#endif

#if BSP_TZ_SECURE_BUILD
    /* Enter non-secure code */
    R_BSP_NonSecureEnter();
#endif
}

#if BSP_TZ_SECURE_BUILD

FSP_CPP_HEADER
BSP_CMSE_NONSECURE_ENTRY void template_nonsecure_callable ();

/* Trustzone Secure Projects require at least one nonsecure callable function in order to build (Remove this if it is not required to build). */
BSP_CMSE_NONSECURE_ENTRY void template_nonsecure_callable ()
{

}
FSP_CPP_FOOTER

#endif
