# R7FA6T3BB register map
Vendor: Renesas Electronics Corporation; Series: RA6; File version: 1.30.00
Arm Cortex-M33 based Microcontroller RA6T3 group
CPU: CM33 r0p4, little endian, MPU, FPU, VTOR, 4 interrupt priority bits, 96 interrupts
Registers are 32-bit, read-write, reset 0x0 unless marked. A register's access mark holds for its fields unless they carry their own. Offsets are from the block's base; lines under a group give offsets from that group; [hi:lo] are bit positions; {n}, {i} and the like mark numbered series; 'fields as' and 'values as' point back to an identical list; <NAME> marks a mode.

## Memory map
0x40000000 RMPU blocks up to offset 0x288 — Renesas Memory Protection Unit
0x40000E00 TZF blocks up to offset 0x6 — TrustZone Filter
0x40002000 SRAM blocks up to offset 0xD9 — SRAM Control
0x40003000 BUS blocks up to offset 0x1A38 — Bus Control
{0x40005000+0x40*n} DMAC{n} blocks up to offset 0x30 (n=0..7) — Direct memory access controller {n}
0x40005200 DMA blocks up to offset 0x44 — DMAC Module Activation
0x40005400 DTC blocks up to offset 0x24 — Data Transfer Controller
0x40006000 ICU blocks up to offset 0x480 — Interrupt Controller
0x40007000 CACHE blocks up to offset 0x208
0x40008000 CPSCU blocks up to offset 0x1B4 — CPU System Security Control Unit
0x4001B000 DBG blocks up to offset 0x14 — Debug Function
0x4001C100 FCACHE blocks up to offset 0x42 — SYSTEM/FLASH
0x4001E000 SYSC blocks up to offset 0x493 — System Control
0x40021000 TFU blocks up to offset 0x20 — Trigonometric Function Unit
0x40080000 PORT0 size 0xC — Pmn Pin FunctionPort 0 Control RegistersPmn Pin Function Control Register
0x40080020 PORT1 size 0x10 — Pmn Pin FunctionPort 1 Control RegistersPmn Pin Function Control Register
0x40080040 PORT2 size 0x10 — Pmn Pin FunctionPort 2 Control RegistersPmn Pin Function Control Register
0x40080060 PORT3 size 0x10 — Pmn Pin FunctionPort 3 Control RegistersPmn Pin Function Control Register
0x40080080 PORT4 size 0x10 — Pmn Pin FunctionPort 4 Control RegistersPmn Pin Function Control Register
0x400800A0 PORT5 size 0xC — Pmn Pin FunctionPort 5 Control RegistersPmn Pin Function Control Register
0x40080100 PORT8 size 0xC — Pmn Pin FunctionPort 8 Control RegistersPmn Pin Function Control Register
0x40080800 PFS blocks up to offset 0x522 — Control Register
0x40082000 ELC blocks up to offset 0x7E — Event Link Controller
0x40083000 RTC blocks up to offset 0x44 — Realtime Clock
0x40083200 IWDT blocks up to offset 0x6 — Independent Watchdog Timer
0x40083400 WDT blocks up to offset 0x9 — Watchdog Timer
0x40083600 CAC blocks up to offset 0xC — Clock Frequency Accuracy Measurement Circuit
0x40084000 MSTP size 0x14 — Module Stop Control
0x4008A000 POEG blocks up to offset 0x304 — Port Output Enable Module for GPT
0x40090000 USBFS blocks up to offset 0x408 — USB 2.0 Full-Speed Module
0x400B0000 CANFD_B blocks up to offset 0x17C8 — CANFD
0x400E0000 PSCU blocks up to offset 0x2C — Peripheral Security Control Unit
0x400E8000 AGTW0 blocks up to offset 0x14 — Low Power Asynchronous General Purpose Timer 0
0x400E8100 AGTW1 blocks up to offset 0x14 — Low Power Asynchronous General Purpose Timer 1
0x400F3000 TSN size 0x1 — Temperature Sensor
0x400F4000 ACMPHS0 blocks up to offset 0x11 — High-Speed Analog Comparator 0
0x400F4100 ACMPHS1 blocks up to offset 0x11 — High-Speed Analog Comparator 1
0x400F4200 ACMPHS2 blocks up to offset 0x11 — High-Speed Analog Comparator 2
0x40108000 CRC blocks up to offset 0xC — Cyclic Redundancy Check Calculator
0x40109000 DOC blocks up to offset 0x6 — Data Operation Circuit
0x40118000 SCI0 blocks up to offset 0x26 — Serial Communication Interface
0x40118900 SCI9 blocks up to offset 0x26 — Serial Communication Interface
0x4011A000 SPI0 blocks up to offset 0x22 — Serial Peripheral Interface 0
0x4011A100 SPI1 blocks up to offset 0x22 — Serial Peripheral Interface 1
0x4011F000 I3C blocks up to offset 0x3E8 — I3C Bus Interface
0x4012F200 ECCMB blocks up to offset 0x14
0x40169000 GPT16E0 blocks up to offset 0xD8 — General PWM 16-bit Timer 0
0x40169100 GPT16E1 blocks up to offset 0xD8 — General PWM 16-bit Timer 1
0x40169200 GPT16E2 blocks up to offset 0xD8 — General PWM 16-bit Timer 2
0x40169300 GPT16E3 blocks up to offset 0xD8 — General PWM 16-bit Timer 3
0x40169400 GPT16E4 blocks up to offset 0xD8 — General PWM 16-bit Timer 4
0x40169500 GPT16E5 blocks up to offset 0xD8 — General PWM 16-bit Timer 5
0x40169A00 GPT_OPS size 0x4 — Output Phase Switching Controller
0x40170000 ADC120 blocks up to offset 0x1B2 — 12-bit A/D Converter
0x40171000 DAC12 blocks up to offset 0x10C1 — 12-bit D/A converter
0x407FB000 TSD blocks up to offset 0x180 — Temperature Sensor Calibration Data
0x407FC000 FLAD blocks up to offset 0x41 — Data Flash
0x407FE000 FACI blocks up to offset 0xEA — Flash/CPU Interface

## Interrupts
{n} IEL{n} (ICU) (n=0..95) — ICU Interrupt {n}

## Licence text in the file
This software is supplied by Renesas Electronics Corporation and is only intended for use with Renesas products. No other uses are authorized. This software is owned by. Renesas Electronics Corporation and is protected under all applicable laws, including copyright laws. . THIS SOFTWARE IS PROVIDED "AS IS" AND RENESAS MAKES NO WARRANTIES REGARDING. THIS SOFTWARE, WHETHER EXPRESS, IMPLIED OR STATUTORY, INCLUDING BUT NOT LIMITED TO. WARRANTIES OF MERCHANTABILITY, FITNESS FOR A PARTICULAR PURPOSE AND NON-INFRINGEMENT. ALL SUCH WARRANTIES ARE EXPRESSLY DISCLAIMED. TO THE MAXIMUM EXTENT PERMITTED NOT. PROHIBITED BY LAW, NEITHER RENESAS ELECTRONICS CORPORATION NOR ANY OF ITS AFFILIATED. COMPANIES SHALL BE LIABLE FOR ANY DIRECT, INDIRECT, SPECIAL, INCIDENTAL OR CONSEQUENTIAL. DAMAGES FOR ANY REASON RELATED TO THIS SOFTWARE, EVEN IF RENESAS OR ITS AFFILIATES HAVE. BEEN ADVISED OF THE POSSIBILITY OF SUCH DAMAGES. . Renesas reserves the right, without notice, to make changes to this software and to discontinue the availability of this software. By using this software, you agree to the additional terms and conditions found by accessing the following link: http://www.renesas.com/disclaimer
