# R7FA2T107 register map
Vendor: Renesas Electronics Corporation; Series: RA2; File version: 1.00.00
Arm Cortex-M23 based Microcontroller RA2T1 device
CPU: CM23 r1p0, little endian, MPU, no FPU, VTOR, 2 interrupt priority bits, 32 interrupts
Registers are 8-bit, read-write, reset 0x0 unless marked. A register's access mark holds for its fields unless they carry their own. Offsets are from the block's base; lines under a group give offsets from that group; [hi:lo] are bit positions; {n}, {i} and the like mark numbered series; 'fields as' and 'values as' point back to an identical list; <NAME> marks a mode.

## Memory map
0x40000000 RMPU blocks up to offset 0xD20 — Renesas Memory Protection Unit
0x40002000 SRAM blocks up to offset 0x5 — SRAM Control
0x40003000 BUS blocks up to offset 0x1835 — BUS Control
0x40005400 DTC blocks up to offset 0x10 — Data Transfer Controller
0x40006000 ICU blocks up to offset 0x380 — Interrupt Controller Unit
0x4001B000 DBG blocks up to offset 0x14 — Debug Function
0x4001E000 SYSC blocks up to offset 0x493 — System Control
0x40040000 PORT0 size 0xC — Port 0 Control Registers
0x40040020 PORT1 size 0x10 — Port 1 Control Registers
0x40040040 PORT2 size 0x10 — Port 2 Control Registers
0x40040060 PORT3 size 0xC — Port 3 Control Registers
0x40040080 PORT4 size 0xC — Port 4 Control Registers
0x400400A0 PORT5 size 0xC — Port 5 Control Registers
0x40040120 PORT9 size 0xC — Port 9 Control Registers
0x40040800 PFS blocks up to offset 0x510 — Pmn Pin Function Control Register
0x40041000 ELC blocks up to offset 0x50 — Event Link Controller
0x40042000 POEG blocks up to offset 0x146 — Port Output Enable Module for GPT
0x40044200 WDT blocks up to offset 0x9 — Watchdog Timer
0x40044400 IWDT blocks up to offset 0x6 — Independent Watchdog Timer
0x40044600 CAC blocks up to offset 0xC — Clock Frequency Accuracy Measurement Circuit
0x40047000 MSTP size 0xE — Module Stop Control B, C, D
0x40053000 IIC0 size 0x14 — Inter-Integrated Circuit 0
0x40053014 IIC0WU blocks up to offset 0x4 — Inter-Integrated Circuit 0 Wake-up Unit
0x40054100 DOC blocks up to offset 0x6 — Data Operation Circuit
0x4005C000 ADC120 blocks up to offset 0xEB — 12-bit A/D Converter
0x40070000 SCI0 size 0x1D — Serial Communication Interface 0
0x40070020 SCI1 blocks up to offset 0x1D — Serial Communication Interface 1
0x40070040 SCI2 blocks up to offset 0x1D — Serial Communication Interface 2
0x40070120 SCI9 blocks up to offset 0x1D — Serial Communication Interface 9
0x40072000 SPI0 blocks up to offset 0x12 — Serial Peripheral Interface 0
0x40074000 CRC blocks up to offset 0xE — Cyclic Redundancy Check
0x40080000 KINT blocks up to offset 0x9 — Key Interrupt Function
0x40084000 AGTW0 size 0x13 — Low Power Asynchronous General Purpose Timer 0
0x40084100 AGTW1 size 0x13 — Low Power Asynchronous General Purpose Timer 1
0x40085E00 ACMPHS blocks up to offset 0xC — High-Speed Analog Comparator
0x40089000 GPT160 blocks up to offset 0xF0 — General PWM 16-bit Timer 0
0x40089100 GPT161 blocks up to offset 0xF0 — General PWM 16-bit Timer 1
0x40089200 GPT162 blocks up to offset 0xF0 — General PWM 16-bit Timer 2
0x40089300 GPT163 blocks up to offset 0xF0 — General PWM 16-bit Timer 3
0x40089A00 GPT_OPS size 0x4 — Output Phase Switching Controller
0x407EC000 FLCN blocks up to offset 0x3FC9 — Flash I/O Registers

## Interrupts
{n} IEL{n} (ICU) (n=0..31) — ICU Interrupt {n}

## Licence text in the file
This software is supplied by Renesas Electronics Corporation and is only intended for use with Renesas products. No other uses are authorized. This software is owned by. Renesas Electronics Corporation and is protected under all applicable laws, including copyright laws. . THIS SOFTWARE IS PROVIDED "AS IS" AND RENESAS MAKES NO WARRANTIES REGARDING. THIS SOFTWARE, WHETHER EXPRESS, IMPLIED OR STATUTORY, INCLUDING BUT NOT LIMITED TO. WARRANTIES OF MERCHANTABILITY, FITNESS FOR A PARTICULAR PURPOSE AND NON-INFRINGEMENT. ALL SUCH WARRANTIES ARE EXPRESSLY DISCLAIMED. TO THE MAXIMUM EXTENT PERMITTED NOT. PROHIBITED BY LAW, NEITHER RENESAS ELECTRONICS CORPORATION NOR ANY OF ITS AFFILIATED. COMPANIES SHALL BE LIABLE FOR ANY DIRECT, INDIRECT, SPECIAL, INCIDENTAL OR CONSEQUENTIAL. DAMAGES FOR ANY REASON RELATED TO THIS SOFTWARE, EVEN IF RENESAS OR ITS AFFILIATES HAVE. BEEN ADVISED OF THE POSSIBILITY OF SUCH DAMAGES. . Renesas reserves the right, without notice, to make changes to this software and to discontinue the availability of this software. By using this software, you agree to the additional terms and conditions found by accessing the following link: http://www.renesas.com/disclaimer
